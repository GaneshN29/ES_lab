	AREA RESET,DATA, READONLY   ;OVERLAPPING
	EXPORT __Vectors
__Vectors
	DCD 0x40001000
	DCD Reset_Handler
	ALIGN
	AREA mycode, CODE, READONLY
	ENTRY
	EXPORT Reset_Handler
Reset_Handler
 LDR R1,=SRC
 LDR R2,=DST
 LDR R3,=ANS
 MOV R4,#4
 MOV R5,#0
 mov R6,#0 ;CARRY
 MOV R9,#0 ;CARRY
BACK
 LDR R7,[R1],#4
 LDR R8,[R2],#4
 ADDS R5,R7,R8
 MOV R9,#0
 ADC R9,#0
 ADDS R5,R6
 MOV R6,#0
 ADC R6,R9

 STR R5,[R3],#4
 SUBS R4,#1
 BNE BACK
  STR R6,[R3]
STOP B STOP
SRC DCD 0xfFFFFFFF,0xfFFFFFFF,0xfFFFFFFF,0xfFFFFFFF
DST DCD 0xfFFFFFFF,0xfFFFFFFF,0xfFFFFFFF,0xfFFFFFFF
 AREA DATA1, DATA, READWRITE
ANS DCD 0
END